## conf/layer.conf
```bitbake
# We have a conf and classes directory, add to BBPATH
BBPATH .= ":${LAYERDIR}"

# We have recipes-* directories, add to BBFILES
BBFILES += "${LAYERDIR}/recipes-*/*/*.bb \
            ${LAYERDIR}/recipes-*/*/*.bbappend"

BBFILE_COLLECTIONS += "meta-uboot-rpi5"
BBFILE_PATTERN_meta-uboot-rpi5 = "^${LAYERDIR}/"
BBFILE_PRIORITY_meta-uboot-rpi5 = "6"

LAYERDEPENDS_meta-uboot-rpi5 = "core"
LAYERSERIES_COMPAT_meta-uboot-rpi5 = "kirkstone"
```
